## firmware/main/Kconfig.projbuild
```kconfig
menu "Balabala diagnostics"
    config BALABALA_AUTOTEST
        bool "Unattended isolated diagnostic"
        default n
        help
            Fixed phase 1 learning/storage or phase 2 BLE script with exclusive SD root.
            Phase 2 uses RAM Wi-Fi storage and never restarts. No ROM script.
            Diagnostic images are not delivery images.
    config BALABALA_AUTOTEST_PHASE
        int "Diagnostic phase"
        depends on BALABALA_AUTOTEST
        range 1 2
        default 1
    config BALABALA_MEMORY_DIAGNOSTICS
        bool "Log memory at application stage boundaries"
        default n
        help
            Samples INTERNAL|8BIT free/minimum/largest block and the main task
            stack watermark. Largest-block and watermark queries scan memory;
            enable only for diagnosis. Stage samples can miss transient peaks.
            Rust allocation failure records these values regardless of this flag.
endmenu
```

## firmware/sdkconfig.defaults
```kconfig
# 原版X4构建配置；构建通过不代表设备验收，不据此直接烧录。
CONFIG_IDF_TARGET="esp32c3"
CONFIG_ESPTOOLPY_FLASHSIZE_16MB=y
# 沿用已备份旧固件DIO 40MHz，减少首次验证变量；不代表Flash不支持80MHz。
CONFIG_ESPTOOLPY_FLASHMODE_DIO=y
CONFIG_ESPTOOLPY_FLASHFREQ_40M=y
CONFIG_COMPILER_OPTIMIZATION_SIZE=y
# 旧探针入口固定栈帧26592B已超过16KiB；64KiB只是待真机验证起点。
CONFIG_ESP_MAIN_TASK_STACK_SIZE=65536
# 释放C3共享SRAM供BLE配网；Wi-Fi吞吐/时延代价仍待真机验证。
CONFIG_ESP_WIFI_RX_IRAM_OPT=n
CONFIG_ESP_WIFI_IRAM_OPT=n
# 原版X4实测16MiB；NVS/PHY及factory起始地址保持，应用分区覆盖剩余Flash。
CONFIG_PARTITION_TABLE_CUSTOM=y
CONFIG_PARTITION_TABLE_CUSTOM_FILENAME="partitions.csv"

# 5ms输入采样/显示等待调度；闲时DFS降到40MHz，工作由RTOS/驱动锁恢复性能。
CONFIG_FREERTOS_HZ=200
CONFIG_PM_ENABLE=y

# 官方Security1 BLE配网；可重复开关，不释放不可逆的BT内存。
CONFIG_BT_ENABLED=y
CONFIG_BT_NIMBLE_ENABLED=y
CONFIG_BT_BLUEDROID_ENABLED=n
# 按需分配移除整池预分配；归还即释放，运行峰值与分配时延待真机验证。
CONFIG_BT_NIMBLE_MEMPOOL_RUNTIME_ALLOC=y
CONFIG_BT_NIMBLE_MEMPOOL_BLOCK_REUSED=n
CONFIG_BT_NIMBLE_STATIC_TO_DYNAMIC=y
CONFIG_BT_NIMBLE_MAX_CONNECTIONS=1
CONFIG_BT_CTRL_BLE_MAX_ACT=2
CONFIG_ESP_WIFI_STATIC_RX_BUFFER_NUM=6
# 保留协议容量；RX静态缓冲不低于BA窗口。
CONFIG_BT_NIMBLE_TRANSPORT_ACL_FROM_LL_COUNT=24
CONFIG_BT_NIMBLE_TRANSPORT_ACL_SIZE=255
CONFIG_BT_NIMBLE_MSYS_1_BLOCK_COUNT=12
CONFIG_BT_NIMBLE_MSYS_1_BLOCK_SIZE=256
CONFIG_BT_NIMBLE_MSYS_2_BLOCK_COUNT=24
CONFIG_BT_NIMBLE_MSYS_2_BLOCK_SIZE=320
CONFIG_BT_NIMBLE_ATT_PREFERRED_MTU=256
CONFIG_BT_NIMBLE_ATT_MAX_PREP_ENTRIES=64
CONFIG_ESP_WIFI_RX_BA_WIN=6
CONFIG_ESP_PROTOCOMM_SUPPORT_SECURITY_VERSION_0=n
CONFIG_ESP_PROTOCOMM_SUPPORT_SECURITY_VERSION_1=y
CONFIG_ESP_PROTOCOMM_SUPPORT_SECURITY_VERSION_2=n
CONFIG_NETWORK_PROV_KEEP_BLE_ON_AFTER_PROV=n
CONFIG_ESP_PROTOCOMM_KEEP_BLE_ON_AFTER_BLE_STOP=n
CONFIG_NETWORK_PROV_AUTOSTOP_TIMEOUT=30
```
